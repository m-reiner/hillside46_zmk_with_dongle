## config/boards/shields/hillside46/Kconfig.shield
```kconfig
config SHIELD_HILLSIDE46
    bool

config SHIELD_HILLSIDE46_DONGLE
    def_bool $(shields_list_contains,hillside46_dongle)
    select ZMK_SPLIT_ROLE_CENTRAL
    select ZMK_SPLIT
    select SHIELD_HILLSIDE46

config SHIELD_HILLSIDE46_LEFT
    def_bool $(shields_list_contains,hillside46_left)
    select ZMK_SPLIT
    select SHIELD_HILLSIDE46

config SHIELD_HILLSIDE46_RIGHT
    def_bool $(shields_list_contains,hillside46_right)
    select ZMK_SPLIT
    select SHIELD_HILLSIDE46
```
